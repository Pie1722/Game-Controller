//Gamepad Library
#include <Gamepad.h>

//SENSOR LIBRARIES  -------------------------------
#include <Adafruit_SSD1306.h>
#include <Adafruit_GFX.h>
#include <SPI.h>
#include <Wire.h>
#include <DS3231.h>

int rightXcenter = 500;
int rightYcenter = 500;
int leftXcenter = 500;
int leftYcenter = 500;
double multiplierRX = 0.254; //127 / 500
double multiplierRY = 0.254;
double multiplierLX = 0.254;
double multiplierLY = 0.254;

Gamepad gp;

// bmp image size
#define bitmap_height   109
#define bitmap_width    55

#define SCREEN_WIDTH 128 // OLED display width, in pixels
#define SCREEN_HEIGHT 64 // OLED display height, in pixels

#define OLED_RESET     -1// Reset pin # (or -1 if sharing Arduino reset pin)
Adafruit_SSD1306 display(SCREEN_WIDTH, SCREEN_HEIGHT, &Wire, OLED_RESET);

DS3231 clock;
RTCDateTime dt;

static const unsigned char PROGMEM bitmap [] = {
0x00, 0x00, 0x00, 0x00, 0x00, 0x00, 0x00, 0x00, 0x00, 0x00, 0x00, 0x00, 0x00, 0x00, 0x00, 0x00,
0x00, 0x00, 0x00, 0x00, 0x00, 0x00, 0x00, 0x00, 0x00, 0x00, 0x00, 0x00, 0x00, 0x00, 0x00, 0x00,
0x00, 0x00, 0x00, 0x00, 0x00, 0x00, 0x00, 0x00, 0x00, 0x00, 0x00, 0x00, 0x00, 0x00, 0x00, 0x00,
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0xCB, 0x46, 0xF6, 0xFE, 0x15, 0xE8, 0x0B, 0xCE, 0x82, 0x9A, 0x32, 0xEF, 0x90, 
};

void setup() {

  pinMode(A0, INPUT);
  pinMode(A1, INPUT);
  pinMode(A2, INPUT);
  pinMode(A3, INPUT);
  pinMode(14,  INPUT_PULLUP); //UPPER RIGHT
  pinMode(15,  INPUT_PULLUP); //UPPER LEFT
  pinMode(1,  INPUT_PULLUP); //LEFTBUTTON
  pinMode(0,  INPUT_PULLUP); //RIGHTBUTTON
  pinMode(4,  INPUT_PULLUP); //UP
  pinMode(5,  INPUT_PULLUP); //DOWN
  pinMode(6,  INPUT_PULLUP); //LEFT
  pinMode(7,  INPUT_PULLUP); //RIGHT
  pinMode(8,  INPUT_PULLUP); //Y
  pinMode(9,  INPUT_PULLUP); //X
  pinMode(10,  INPUT_PULLUP); //A
  pinMode(16,  INPUT_PULLUP); //B  
  
  calibrate();

  if (! clock.begin()) {      //   initialize RTC
    Serial.println("Couldn't find RTC");
    while (1);
  }
    // If the RTC have lost power it will set the RTC to the date & time this sketch was compiled in the following line
   clock.setDateTime(__DATE__, __TIME__);  // set time from computer time
    // This line sets the RTC with an explicit date & time, for example to set
    // January 21, 2014 at 3am you would call:
    // rtc.adjust(DateTime(2014, 1, 21, 3, 0, 0));

  // If you need to set the time of the uncomment line 34 or 37
  // following line sets the RTC to the date & time this sketch was compiled
  // clock,setDateTime(DateTime(F(__DATE__), F(__TIME__)));
  // This line sets the RTC with an explicit date & time, for example to set
  // January 21, 2014 at 3am you would call:
  // rtc.adjust(DateTime(2014, 1, 21, 3, 0, 0));

  //SSD1306_SWITCHCAPVCC = generate display voltage from 3.3V internally
  if (!display.begin(SSD1306_SWITCHCAPVCC, 0x3D)) {                        // Address 0x3C for 128x32 & 0x3D for 128x64
    Serial.println(F("SSD1306 allocation failed"));
    for (;;) ;                                                            // Don't proceed, loop forever
  }
  display.setTextSize(1);
  display.setTextColor(WHITE);
  display.setRotation(0);
  display.clearDisplay();               // clear the buffer

  showBitmap();                         // print image in oled display

}

  String DayOfTheWeek(uint8_t Day){
  String DayText;
  if (Day==1)  DayText="Monday";
  if (Day==2)  DayText="Tuesday";
  if (Day==3)  DayText="Wednesday";
  if (Day==4)  DayText="Thursday";
  if (Day==5)  DayText="Friday";
  if (Day==6)  DayText="Saturday";
  if (Day==7)  DayText="Sunday";
  return DayText;
}

String AddLeadingZero(uint8_t x){
  String AddLeadingZeroText;
  if(x<10) AddLeadingZeroText="0"; 
  else AddLeadingZeroText=""; 
  AddLeadingZeroText=AddLeadingZeroText+x;
  return AddLeadingZeroText;
}

String CurrentTime(uint8_t h, uint8_t i ){
  String CurrentTimeText="";
  CurrentTimeText=CurrentTimeText + AddLeadingZero(h) +":"+AddLeadingZero(i);
  return CurrentTimeText;
}

void loop(){
  
  display.clearDisplay();
  display.setCursor(0, 0);
  
   int lx, ly, rx, ry;
  lx = analogRead(A3);
  ly = analogRead(A2);
  rx = analogRead(A1);
  ry = analogRead(A0);
  
  //we need to convert a 0-1000 to -127 - 127
  
  lx = floor((lx - leftXcenter) * multiplierLX);
  ly = floor((ly - leftYcenter) * multiplierLY);
  rx = floor((rx - rightXcenter) * multiplierRX);
  ry = floor((ry - rightYcenter) * multiplierRY);
  
  if(lx > 127) lx = 127;
  if(ly > 127) ly = 127;
  if(rx > 127) rx = 127;
  if(ry > 127) ry = 127;
  
  gp.setLeftXaxis(lx);
  gp.setRightXaxis(rx);
  gp.setLeftYaxis(ly);
  gp.setRightYaxis(ry);
  
  int UPLEFT, UPRIGHT, UP, DOWN, LEFT, RIGHT, RIGHTBUTTON, LEFTBUTTON, X, Y, A, B;
  
  UPLEFT = digitalRead(14);
  UPRIGHT = digitalRead(15);
  
  RIGHTBUTTON = digitalRead(0);
  LEFTBUTTON = digitalRead(1);
  
  UP = digitalRead(4);
  DOWN = digitalRead(5);
  
  LEFT = digitalRead(6);
  RIGHT = digitalRead(7);
  
  X = digitalRead(8);
  Y = digitalRead(9);
  A = digitalRead(10);
  B = digitalRead(16);
  
      
  
  if(UPLEFT == LOW)    //
    gp.setButtonState(0, true);
  else
    gp.setButtonState(0, false);

  if(UPRIGHT == LOW)
    gp.setButtonState(1, true);
  else
    gp.setButtonState(1, false);
 
  if(UP == LOW)
    gp.setButtonState(2, true);
  else
    gp.setButtonState(2, false);

  if(DOWN == LOW)
    gp.setButtonState(3, true);
  else
    gp.setButtonState(3, false);    

  if(LEFT == LOW)
    gp.setButtonState(4, true);
  else
    gp.setButtonState(4, false); 

  if(RIGHT == LOW)
    gp.setButtonState(5, true);
  else
    gp.setButtonState(5, false);     

  if(RIGHTBUTTON == LOW)
    gp.setButtonState(6, true);
  else
    gp.setButtonState(6, false);   

  if(LEFTBUTTON == LOW)
    gp.setButtonState(7, true);
  else
    gp.setButtonState(7, false);     

  if(X == LOW)
    gp.setButtonState(8, true);
  else
    gp.setButtonState(8, false);

  if(Y == LOW)
    gp.setButtonState(9, true);
  else
    gp.setButtonState(9, false);

  if(A == LOW)
    gp.setButtonState(10, true);
  else
    gp.setButtonState(10, false);  

  if(B == LOW)
    gp.setButtonState(11, true);
  else
    gp.setButtonState(11, false);       

     dt = clock.getDateTime();

  display.fillRect(0,0,128,16,SSD1306_WHITE);
  display.fillRect(0,16,128,28,SSD1306_BLACK);
  display.fillRect(0,28,128,46,SSD1306_WHITE);
  display.fillRect(0,46,128,64,SSD1306_BLACK);

    display.setCursor(15,1); 
    display.setTextSize(2);
    display.setTextColor(SSD1306_BLACK); 
    display.println(DayOfTheWeek(dt.dayOfWeek));

    display.setCursor(15,30); 
    display.setTextSize(2);  
    display.setTextColor(SSD1306_BLACK); 
    display.println(CurrentTime(dt.hour,dt.minute));

     display.setCursor(75,30); 
  display.setTextSize(2);
  display.setTextColor(SSD1306_BLACK); 
  display.println(":");

  display.setCursor(87,30); 
  display.setTextSize(2);
  display.setTextColor(SSD1306_BLACK); 
  display.println(AddLeadingZero(dt.second));

    display.setCursor(2,48); 
  display.setTextSize(2);
  display.setTextColor(SSD1306_WHITE); 
  display.println("Temp");

  clock.forceConversion();
  display.setCursor(55,48); 
  display.setTextSize(2);
display.setTextColor(SSD1306_WHITE); 
display.print(clock.readTemperature());
display.setCursor(116,46); 
display.setTextSize(1);
display.print("o");

display.display();
}

void calibrate(){
  
  int lx, ly, rx, ry;
  int i = 0;
  while(i < 13)
  {
    lx = analogRead(A3);
    ly = analogRead(A2);
    rx = analogRead(A1);
    ry = analogRead(A0);
    bool validLX = lx > (leftXcenter - 100) && lx < (leftXcenter + 100);
    bool validLY = ly > (leftYcenter - 100) && ly < (leftYcenter + 100);
    bool validRX = rx > (rightXcenter - 100) && rx < (rightXcenter + 100);
    bool validRY = ry > (rightYcenter - 100) && ry < (rightYcenter + 100);
    if(validLX && validLY && validRX && validRY)
    {
      i++;
      //nothing to do here!
    }
    else i = 0;
  }
  
  leftXcenter = lx;
  leftYcenter = ly;
  rightXcenter = rx;
  rightYcenter = ry;
  multiplierLX = (double)127 / (double)lx;
  multiplierLY = (double)127 / (double)ly;
  multiplierRX = (double)127 / (double)rx;
  multiplierRY = (double)127 / (double)ry;
  
}

void showBitmap(void) {
  
  display.clearDisplay();
  display.drawBitmap(0, 0, bitmap, bitmap_height, bitmap_width, WHITE);
  display.display();
  delay(2500);
  
  display.invertDisplay(true);                  //inverse the colour
  
  display.clearDisplay();
  display.drawBitmap(0, 0, bitmap, bitmap_height, bitmap_width, WHITE);
  display.display();
  delay(2500);
  
}
